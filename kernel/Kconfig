## kernel/Kconfig
```kconfig
menu "KernelSU"

config KSU
	tristate "KernelSU function support"
	depends on KPROBES && EXT4_FS
	default y
	help
	  Enable kernel-level root privileges on Android System.
	  Requires CONFIG_KPROBES for kernel hooking support.
	  Requires CONFIG_EXT4_FS for `ext4_unregister_sysfs`.
	  To compile as a module, choose M here: the
	  module will be called kernelsu.

config KSU_DEBUG
	bool "KernelSU debug mode"
	depends on KSU
	default n
	help
	  Enable KernelSU debug mode.

config KSU_DISABLE_MANAGER
	bool "Disable KernelSU manager integration"
	depends on KSU
	default n
	help
	  Disable manager APK detection and manager-specific handling.
	  Root will be used in place of manager-only functionality.

config KSU_DISABLE_POLICY
	bool "Disable KernelSU policy profiles"
	depends on KSU
	default n
	help
	  Disable per-app root/non-root profile customization.
	  Escalation will always use the default full root profile, and
	  non-root handling will follow the global umount policy only.

config KSU_X86_PATCH_SYSCALL_DISPATCHER
	bool "Dynamically patch x64's hardened syscall dispatcher to support syscall hooks"
	depends on KSU && X86_64
	default n
	help
	  Dynamically patch x64's hardened syscall dispatcher to support syscall hooks. This is a
	  replacement for a kernel source code patch, and is useful for x86_64 LKM mode.

config KSU_NO_TEXT_POKE
	bool "Late-load ARM64 probe hooks without direct text or syscall-table writes"
	depends on KSU = m && ARM64 && KPROBES && KRETPROBES
	default n
	help
	  Explicit compatibility mode for protected kernels. Supports late-load
	  only. Manager UID handoff and sucompat use kernel kprobes/kretprobes.
	  KernelSU direct patch_text calls return EOPNOTSUPP before stop_machine.
	  SELinux hiding and module-blacklist mutation are disabled in this mode.
	  The compatibility LKM stays pinned until reboot; live unload is disabled.

config KSU_SELF_RESOLVED_DATA
	bool "Resolve protected kernel data into typed module-owned pointers"
	depends on KSU_NO_TEXT_POKE
	default n
	help
	  Resolve SELinux state, LSM blob offsets and mount namespace operations
	  before credentials or hooks are initialized. No external instruction
	  rewriting or facts snapshots are needed. Private function binding is
	  still performed by the pre-load symbol fixer.

config KSU_QUIET
	bool "Compile out routine module logging"
	depends on KSU
	default n
	help
	  Anti-fingerprinting: drop pr_info/pr_warn call sites (boot banner,
	  hook-registration notices, fd-install notices, ioctl denial noise)
	  so neither the ring buffer nor the module image carries routine
	  "KernelSU:" markers. pr_err is kept for genuine failure paths.
	  Every unauthenticated-triggerable log line is in the dropped set.

config KSU_HIDE_MODULE
	bool "Remove the module from /proc/modules and kallsyms after init"
	depends on KSU = m
	default n
	help
	  Anti-fingerprinting: unlink THIS_MODULE from the kernel module list
	  (resolved via kallsyms; module_mutex/modules are not exported) once
	  initialization succeeded. /sys/module was already dropped by
	  kobject_del. Hides the module line from /proc/modules and module
	  symbols from /proc/kallsyms names. The module stays pinned until
	  reboot, matching the KSU_NO_TEXT_POKE no-unload profile.

endmenu
```
